## conf/distro/brownie.conf
```bitbake
# Derive from the Poky reference distribution
require conf/distro/poky.conf

DISTRO = "brownie"
DISTRO_NAME = "Brownie Home Automation Distro"

MAINTAINER = "Joshua Watt <JPEWhacker@gmail.com>"
TARGET_VENDOR = "-brownie"
SDK_VENDOR = "-browniesdk"

SANITY_TESTED_DISTROS_append = " \
    linuxmint-18.1 \n \
    "
```
